# RN821X_RN721X_SOC_V2 register map
File version: v1.0.7
CPU: CM0 r0p0, little endian, no MPU, no FPU, 3 interrupt priority bits
Registers are 32-bit, read-write, reset 0x0 unless marked. A register's access mark holds for its fields unless they carry their own. Offsets are from the block's base; [hi:lo] are bit positions.

## ECT — emu error compensation by temperature
Base 0x40078000
0x00 WREN — write enable register
  [7:0] WREN — write enable bits
0x04 CTRL — configuration register
  [7:0] CTRL — configuration bits
0x08 EN — enable register
  [15:0] EN — enable bits
0x0C STATUS
  [10:0] STATUS — status bits
0x10 IE — interrupt enable register
  [5:0] IE — interrupt enable bits
0x14 LT_SET — low part temperature threshold set register
  [25:0] LT_SET — low part temperature threshold set bits
0x18 HT_SET — high part temperature threshold set register
  [25:0] HT_SET — high part temperature threshold set bits
0x1C TIMER_SET — cycling period set register
  [7:0] TIMER_SET — cycling period set bits
0x20 PROT_TEMP — 25 degree protect threshold register
  [9:0] PROT_TEMP — 25 degree protect threshold bits
0x24 PROT_IAGAIN — IA error protect threshold register
  [15:0] PROT_IAGAIN — IA error protect threshold bits
0x28 PROT_IBGAIN — IB error protect threshold register
  [15:0] PROT_IBGAIN — IB error protect threshold bits
0x2C PROT_UGAIN — U error protect threshold register
  [15:0] PROT_UGAIN — U error protect threshold bits
0x30 LT_KIA — IA low part temperature K coefficient register
  [16:0] LT_KIA — IA low part temperature K coefficient bits
0x34 LT_KIB — IB low part temperature K coefficient register
  [16:0] LT_KIB — IB low part temperature K coefficient bits
0x38 LT_KU — U low part temperature K coefficient register
  [16:0] LT_KU — U low part temperature K coefficient bits
0x3C HT_KIA — IA high part temperature K coefficient register
  [16:0] HT_KIA — IA high part temperature K coefficient bits
0x40 HT_KIB — IB high part temperature K coefficient register
  [16:0] HT_KIB — IB high part temperature K coefficient bits
0x44 HT_KU — U high part temperature K coefficient register
  [16:0] HT_KU — U high part temperature K coefficient bits
0x48 TEMP — current temperature register
  [9:0] TEMP — current temperature bits
0x4C IAGAIN
  [15:0] IAGAIN — IA gain bits
0x50 IBGAIN
  [15:0] IBGAIN — IB gain bits
0x54 UGAIN
  [15:0] UGAIN — U gain bits
0x58 TEMP_UD — current compensation temperature register
  [9:0] TEMP_UD — current compensation temperature bits

## EMU_WAVE — synchronous sampling module
Base 0x40040080
0x00 WKEY — synchronous sampling module write access register
  [7:0] WKEY — synchronous sampling module write access register bits
0x04 WAVECFG — synchronous sampling module cfg register
  [3:0] WAVECFG — synchronous sampling module cfg register bits
0x08 WAVECFG2 — synchronous sampling module cfg register No.2
  [9:0] WAVECFG2 — synchronous sampling module cfg register No.2 bits
0x0C EN — synchronous sampling module enable register
  [0] EN — synchronous sampling module enable register bits
0x10 WAVECNT — WAVECNT sample rate config register
  [9:0] WAVECNT — WAVECNT sample rate config register bits
0x14 DC_EN — synchronous sampling AUTO DC enable register
  [2:0] DC_EN — synchronous sampling AUTO DC enable register bits
0x18 PHSIA — synchronous sampling channel IA phase gain cfg register
  [6:0] PHSIA — synchronous sampling channel IA phase gain cfg register bits
0x1C PHSIB — synchronous sampling channel IB phase gain cfg register
  [6:0] PHSIB — synchronous sampling channel IB phase gain cfg register bits
0x20 PHSU — synchronous sampling channel U phase gain cfg register
  [6:0] PHSU — synchronous sampling channel U phase gain cfg register bits
0x24 IAGAIN — synchronous sampling channel IA gain cfg register
  [15:0] IAGAIN — synchronous sampling channel IA gain cfg register bits
0x28 IBGAIN — synchronous sampling channel IB gain cfg register
  [15:0] IBGAIN — synchronous sampling channel IB gain cfg register bits
0x2C UGAIN — synchronous sampling channel U gain cfg register
  [15:0] UGAIN — synchronous sampling channel U gain cfg register bits
0x50 HW_RMSIA ro — IA channel half wave RMS register
  [23:0] HW_RMSIA — IA channel half wave RMS register bits
0x54 HW_RMSIB ro — IB channel half wave RMS register
  [23:0] HW_RMSIB — IB channel half wave RMS register bits
0x58 HW_RMSU ro — U channel half wave RMS register
  [23:0] HW_RMSU — U channel half wave RMS register bits
0x5C HW_PA ro — A channel half wave active power register
  [31:0] HW_PA — A channel half wave active power register bits
0x60 HW_PB ro — B channel half wave active power register
  [31:0] HW_PB — B channel half wave active power register bits
