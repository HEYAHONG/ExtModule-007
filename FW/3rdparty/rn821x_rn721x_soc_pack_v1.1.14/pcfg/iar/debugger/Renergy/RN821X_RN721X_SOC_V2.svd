# RN821X_RN721X_SOC_V2 register map
File version: v1.0.7
Renergy Metering RN821X RN721X SOC
CPU: CM0 r0p0, little endian, no MPU, no FPU, 3 interrupt priority bits
Registers are 32-bit, read-write, reset 0x0 unless marked. A register's access mark holds for its fields unless they carry their own. Offsets are from the block's base; lines under a group give offsets from that group; [hi:lo] are bit positions; {n}, {i} and the like mark numbered series; 'fields as' and 'values as' point back to an identical list; <NAME> marks a mode.

## Memory map
0x40000000 UART0 size 0x6C — UART tranceiver
0x40004000 UART1 size 0x6C
0x40008000 UART2 size 0x6C
0x4000C000 UART3 size 0x6C
0x40010000 TC0 size 0x34 — A 32-bit timer
0x40014000 TC1 size 0x50 — A 32-bit timer
0x40018000 UART4 size 0x6C
0x4001C000 UART5 size 0x6C
0x40020000 SPI0 size 0x38 — synchronous peripheral interface
0x40024000 I2C size 0x14 — I2C controller
0x40028000 KBI size 0x10 — key detection
0x4002C000 MADC size 0x44 — analog peripherals
0x40030000 WDT size 0x20 — watchdog timer
0x40034000 SYSCTL size 0x11C — system control
0x40038000 ISO7816 size 0x24 — ISO7816 interface
0x4003C000 RTC size 0x18C — real time clock
0x40040000 NVM size 0x58 — no voltage module
0x40040080 EMU_WAVE size 0x64 — synchronous sampling module
0x40044000 INTC size 0x10 — interrupt controller for off-chip interrupt requests
0x40048000 LCD size 0x46 — liquid crystal display
0x40050000 SPI1 size 0x38
0x40054000 SPI2 size 0x38
0x40058000 SPI3 size 0x38
0x4005C000 D2F size 0xB0 — power energy calculation module
0x40060000 SIMP_TC0 size 0xC — simple tc
0x4006000C SIMP_TC1 size 0xC
0x40060018 SIMP_TC2 size 0xC
0x40060024 SIMP_TC3 size 0xC
0x40064000 DSP size 0xA0 — FFT hardware acceleration module
0x40068000 M2M size 0x20 — DMA memory access
0x4006C000 IOCNT size 0x4C — emu pulse forwarding module
0x40070000 LPUART size 0x1C — Flicker calculation module
0x40074000 CRC size 0x30 — crc calibration module
0x40078000 ECT size 0x5C — emu error compensation by temperature
0x50000000 GPIO size 0x110
0x50004000 EMU size 0x4D0 — energy metering unit
0x50020000 FLK size 0x14 — Flicker calculation module

## Interrupts
0 SYSCLKCAL (SYSCTL) — 16 SYSCLK CALC or EMU_RCD(v2/v3) Interrupt
3 RTC — 19 RTC Interrupt
4 EMU — 20 EMU or D2F(v2) Interrupt
5 MADC — 21 MADC or FLK(v2) Interrupt
6 UART0 — 22 UART0 Interrupt
7 UART1 — 23 UART1 Interrupt
8 UART2 — 24 UART2 Interrupt
9 UART3 — 25 UART3 Interrupt
10 SPI0 — 26 SPI0(except v3) Interrupt
11 I2C — 27 IIC Interrupt
12 ISO78160 (ISO7816) — 28 ISO7816 0(except v3) and SPI3(v2/v3) Interrupt
13 ISO78161 (ISO7816) — 29 ISO7816 1(except v3) and SPI2(v2) Interrupt
14 TC0 — 30 Timer/Counter 0(except v3) Interrupt
15 TC1 — 31 Timer/Counter 1 Interrupt
16 UART4 — 32 UART4 Interrupt
17 UART5 — 33 UART5 Interrupt
18 WDT — 34 Watch Dog Interrupt
19 KBI — 35 Key Interrupt
20 LCD — 36 LCD and DSP(v2) Interrupt
23 NVM — 39 NVM or SPI1 Interrupt
24 EXT0 (INTC) — 40 Extern0 Interrupt (or all extern irq)
25 EXT1 (SIMP_TC0) — 41 Extern1 Interrupt (v2/v3 share with simp-tc0)
26 EXT2 (SIMP_TC1) — 42 Extern2 Interrupt (v2/v3 share with simp-tc1)
27 EXT3 (SIMP_TC2) — 43 Extern3 Interrupt (v2/v3 share with simp-tc2)
28 EXT4 (SIMP_TC3) — 44 Extern4 Interrupt (v2/v3 share with simp-tc3)
29 EXT5 (M2M) — 45 Extern5 Interrupt (v2 share with M2M)
30 EXT6 (CRC) — 46 Extern6 Interrupt (v2 share with CRC)
31 EXT7 (ECT) — 47 Extern7 Interrupt (v2 share with ECT)

## CRC — crc calibration module
Base 0x40074000
0x00 DR — crc data register
  [31:0] DR — crc data bits
0x04 STA ro — crc status register
  [0] STA — crc status bits
0x08 CTRL — crc configuration register
  [7:0] CTRL — crc configuration bits
0x0C INIT — crc initial data register
  [31:0] INIT — crc initial data bits
0x10 POL — crc polynomial register
  [31:0] POL — crc polynomial bits
0x14 XOR — crc xor output value register
  [31:0] XOR — crc xor output value bits
0x18 DMA_CTL — crc dma configuration
  [2:0] DMA_CTL — crc dma confibits
0x1C DMA_BADR — crc base address register
  [16:0] DMA_BADR — crc base address bits
0x20 DMA_LEN — crc length register
  [16:0] DMA_LEN — crc length bits
0x24 DMA_ADR — crc current address register
  [16:0] DMA_ADR — crc current address bits
0x28 DMA_IE — crc interrupt enable register
  [0] DMA_IE — crc interrupt enable bits
0x2C DMA_FLG — crc flag register
  [0] DMA_FLG — crc flag bits
